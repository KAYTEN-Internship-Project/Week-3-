VERSION ""

NS_ :

BS_:
BU_: TC375 PCAN

BO_ 1024 TC375_Volt: 8 TC375
   SG_ Voltage_V : 6|12@1+ (0.01,0) [0|40.95] "V" PCAN

BO_ 1280 TC375_Curr: 8 TC375
   SG_ Current_A : 16|8@1+ (0.1,0) [0|25.5] "A" PCAN

BO_ 1536 TC375_Temp: 8 TC375
   SG_ Temperature_C : 32|12@1+ (0.1,0) [0|409.5] "degC" PCAN

CM_ BO_ 1024 "Voltage value (raw/100). startBit=6 len=12, Intel LSB0.";
CM_ SG_ 1024 Voltage_V "Voltage; factor=0.01; offset=0.";
CM_ BO_ 1280 "Current value (raw/10). startBit=16 len=8, Intel LSB0.";
CM_ SG_ 1280 Current_A "Current; factor=0.1; offset=0.";
CM_ BO_ 1536 "Temperature value (raw/10). startBit=32 len=12, Intel LSB0.";
CM_ SG_ 1536 Temperature_C "Temperature; factor=0.1; offset=0.";

BA_DEF_ BO_ "GenMsgBackgroundColor" STRING ;
BA_DEF_ BO_ "GenMsgForegroundColor" STRING ;
BA_DEF_DEF_ "GenMsgBackgroundColor" "#ffffff";
BA_DEF_DEF_ "GenMsgForegroundColor" "#000000";
