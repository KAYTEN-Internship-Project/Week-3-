VERSION "TC375 Lite CAN-UART Demo DBC v1"

NS_ :

BS_:

BU_: TC375 PCAN

BO_ 1024 PCAN_Volt: 8 PCAN
 SG_ Voltage_V : 6|12@1+ (0.01,0) [0|40.95] "V" TC375

BO_ 1280 PCAN_Curr: 8 PCAN
 SG_ Current_A : 16|8@1+ (0.1,0) [0|25.5] "A" TC375

BO_ 1536 PCAN_Temp: 8 PCAN
 SG_ Temperature_C : 32|12@1+ (0.1,0) [0|409.5] "degC" TC375

CM_ BO_ 1024 "Voltage value (raw/100). startBit=6 len=12, Intel LSB0.";
CM_ SG_ 1024 Voltage_V "Voltage; factor=0.01; offset=0.";
CM_ BO_ 1280 "Current value (raw/10). startBit=16 len=8, Intel LSB0.";
CM_ SG_ 1280 Current_A "Current; factor=0.1; offset=0.";
CM_ BO_ 1536 "Temperature value (raw/10). startBit=32 len=12, Intel LSB0.";
CM_ SG_ 1536 Temperature_C "Temperature; factor=0.1; offset=0.";

# --- Optional: show both possible transmitters (PCAN normally, TC375 when test-TX enabled)
BO_TX_BU_ 1024 PCAN,TC375;
BO_TX_BU_ 1280 PCAN,TC375;
BO_TX_BU_ 1536 PCAN,TC375;

# --- Useful common attributes (optional)
BA_DEF_  "WarnHigh"        FLOAT 0 10000;        # custom attribute for signal high-warning thresholds

# defaults

# assign thresholds to signals (matches firmware WARNING logic)
BA_ "WarnHigh" SG_ 1024 Voltage_V 15.0;
BA_ "WarnHigh" SG_ 1280 Current_A 10.0;
BA_ "WarnHigh" SG_ 1536 Temperature_C 42.0;
